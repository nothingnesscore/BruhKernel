## android14-6.1/nomount_src/Kconfig
```kconfig
# Kconfig for NoMount

config NOMOUNT
	bool "NoMount Path Redirection Subsystem"
	default y
	help
	  NoMount allows path redirection and virtual file injection
	  without mounting filesystems. Useful for systemless modifications.
```
